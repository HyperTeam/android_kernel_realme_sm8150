## drivers/power/Kconfig
```kconfig
source "drivers/power/avs/Kconfig"
source "drivers/power/reset/Kconfig"
source "drivers/power/supply/Kconfig"
source "drivers/power/oppo/Kconfig"

#ifdef VENDOR_EDIT /* Jianchao.Shi@BSP.CHG.Basic, 2018/01/12, sjc Add for charging */
config OPPO_SM8150Q_CHARGER
	tristate "OPPO SM8150 charger driver"
	depends on MFD_SPMI_PMIC
	help
	  Enables support for the oppo charging framework

config OPPO_CALL_MODE_SUPPORT
	bool "OPPO call mode support"
	help
	  Say Y to include support

config OPPO_SMART_CHARGER_SUPPORT
	bool "OPPO smart charger support"
	help
	  Say Y to include support

config OPPO_CHIP_SOC_NODE
	bool "OPPO chip soc node"
	help
	  Say Y to include support

config OPPO_RTC_DET_SUPPORT
	tristate "OPPO RTC DET SUPPORT"
	default n
	depends on MFD_SPMI_PMIC
	help
	  Say Y to include support

config OPPO_CHECK_CHARGERID_VOLT
	tristate "OPPO CHECK CHARGERID VOLT"
	default n
	depends on MFD_SPMI_PMIC
	help
	  Say Y to include support

config OPPO_SHIP_MODE_SUPPORT
	tristate "OPPO_SHIP_MODE_SUPPORT"
	default n
	depends on MFD_SPMI_PMIC
	help
	  Say Y to include support

config OPPO_SHORT_USERSPACE
	bool "OPPO batt userspace"
	help
	  Say Y to include support
#endif
```
